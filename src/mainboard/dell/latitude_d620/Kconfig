## src/mainboard/dell/latitude_d620/Kconfig
```kconfig
if BOARD_DELL_LATITUDE_D620

config BOARD_SPECIFIC_OPTIONS
	def_bool y
	select SYSTEM_TYPE_LAPTOP
	select CPU_INTEL_SOCKET_M
	select NORTHBRIDGE_INTEL_I945
	select NORTHBRIDGE_INTEL_SUBTYPE_I945GM
	select SOUTHBRIDGE_INTEL_I82801GX
	select HAVE_MP_TABLE
	select HAVE_ACPI_TABLES
	select HAVE_ACPI_RESUME
	select BOARD_ROMSIZE_KB_1024
	select I945_LVDS

config MAINBOARD_DIR
	string
	default dell/latitude_d620

config MAINBOARD_PART_NUMBER
	string
	default "Latitude D620"

config MAX_CPUS
	int
	default 2

endif
```

## src/mainboard/hewlett_packard/hp_probook_6360b/Kconfig
```kconfig
if BOARD_HEWLETT_PACKARD_HP_PROBOOK_6360B

config BOARD_SPECIFIC_OPTIONS
	def_bool y
	select BOARD_ROMSIZE_KB_4096
	select EC_ACPI
	select HAVE_ACPI_RESUME
	select HAVE_ACPI_TABLES
	select INTEL_INT15
	select MAINBOARD_HAS_LIBGFXINIT # FIXME: check this
	select NORTHBRIDGE_INTEL_SANDYBRIDGE
	select SERIRQ_CONTINUOUS_MODE
	select SOUTHBRIDGE_INTEL_BD82X6X
	select SYSTEM_TYPE_LAPTOP
	select USE_NATIVE_RAMINIT

config MAINBOARD_DIR
	string
	default hewlett_packard/hp_probook_6360b

config MAINBOARD_PART_NUMBER
	string
	default "HP ProBook 6360b"

config VGA_BIOS_FILE
	string
	default "pci8086,0126.rom"

config VGA_BIOS_ID
	string
	default "8086,0126"

config DRAM_RESET_GATE_GPIO # FIXME: check this
	int
	default 60

config MAX_CPUS
	int
	default 8

config USBDEBUG_HCD_INDEX # FIXME: check this
	int
	default 2
endif
```
